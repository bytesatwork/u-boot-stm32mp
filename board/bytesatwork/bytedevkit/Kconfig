## board/bytesatwork/bytedevkit/Kconfig
```kconfig
if TARGET_BYTEDEVKIT

config SYS_BOARD
	default "bytedevkit"

config SYS_VENDOR
	default "bytesatwork"

config SYS_CONFIG_NAME
	default "bytedevkit"

choice
	prompt "byteENGINE STM32MP1 DDR size"
	default BYTEENGINE_STM32MP1_RAM_512

config BYTEENGINE_STM32MP1_RAM_512
	bool "512MB"

config BYTEENGINE_STM32MP1_RAM_1024
	bool "1024MB"

endchoice

config CMD_HWID
       bool "read from and program HWID EEPROM and set env vars"
       default y
       help
	  This option enables the U-Boot CLI command `hwid` which enables
	  reading out content from the designated HWID (HardWare ID) EEPROM
	  and programming that ROM.  With that EEPROM byteENGINEs are able to
	  destinguish on which type of board they run and can dynamically
	  pass the right Device-Trees to the Kernel.

menu "bytes at work config tool"

config CMD_BAW_CONFIG
	bool "bawconfig command"
	default y
	help
	  Enable bawconfig command functionality.
	  Command is used to read and write production data.
	  In general the production data is stored in the EEPROM on the module.

config BAW_CONFIG_EEPROM
	bool "bawconfig eeprom support"
	default y
	help
	  Enable bawconfig EEPROM read/write functionality.
	  Allows to read and write the production data to the EEPROM on the
	  module.

config BAW_CONFIG_EEPROM_BUS
	int "bawconfig I2C bus number"
	default 3
	help
	  I2C bus number of production data EEPROM.

config BAW_CONFIG_EEPROM_ADDRESS
	hex "bawconfig I2C address"
	default 0x50
	help
	  I2C address of production data EEPROM.

config BAW_CONFIG_BUILTIN
	bool "bawconfig builtin support"
	default n
	help
	  Enable bawconfig builtin configuration functionality.
	  Uses the define values from the board header.
	  See for example include/configs/bytedevkit.h.

endmenu


source "board/st/common/Kconfig"

endif
```

## configs/stm32mp157_bytedevkit_defconfig
```kconfig
CONFIG_ARM=y
CONFIG_ARCH_STM32MP=y
CONFIG_SYS_MALLOC_F_LEN=0x3000
CONFIG_SPL_MMC_SUPPORT=y
CONFIG_ENV_SIZE=0x1000
CONFIG_SPL=y
CONFIG_TARGET_BYTEDEVKIT=y
CONFIG_SPL_SPI_FLASH_SUPPORT=y
CONFIG_SPL_SPI_SUPPORT=y
# CONFIG_ARMV7_VIRT is not set
CONFIG_SPL_TEXT_BASE=0x2FFC2500
CONFIG_ENV_VARS_UBOOT_CONFIG=y
CONFIG_FIT=y
CONFIG_SUPPORT_RAW_INITRD=y
CONFIG_SYS_MMCSD_RAW_MODE_U_BOOT_USE_PARTITION=y
CONFIG_SYS_MMCSD_RAW_MODE_U_BOOT_PARTITION=3
CONFIG_SPL_I2C_SUPPORT=y
CONFIG_SPL_MTD_SUPPORT=y
CONFIG_SPL_POWER_SUPPORT=y
CONFIG_SYS_SPI_U_BOOT_OFFS=0x80000
CONFIG_SPL_WATCHDOG_SUPPORT=y
CONFIG_HUSH_PARSER=y
CONFIG_CMD_CPUINFO=y
# CONFIG_CMD_BOOTD is not set
CONFIG_CMD_BOOTZ=y
# CONFIG_CMD_ELF is not set
# CONFIG_CMD_IMI is not set
# CONFIG_CMD_XIMG is not set
# CONFIG_CMD_EXPORTENV is not set
# CONFIG_CMD_IMPORTENV is not set
CONFIG_CMD_EEPROM=y
CONFIG_CMD_MEMINFO=y
CONFIG_CMD_MEMTEST=y
CONFIG_CMD_ADC=y
CONFIG_CMD_BIND=y
CONFIG_CMD_CLK=y
CONFIG_CMD_FUSE=y
CONFIG_CMD_GPIO=y
CONFIG_CMD_GPT=y
CONFIG_CMD_I2C=y
CONFIG_CMD_MMC=y
CONFIG_CMD_MTD=y
CONFIG_CMD_PART=y
CONFIG_CMD_REMOTEPROC=y
CONFIG_CMD_SPI=y
CONFIG_CMD_DHCP=y
CONFIG_CMD_MII=y
CONFIG_CMD_PING=y
CONFIG_CMD_PXE=y
CONFIG_CMD_CACHE=y
CONFIG_CMD_TIME=y
CONFIG_CMD_TIMER=y
CONFIG_CMD_PMIC=y
CONFIG_CMD_REGULATOR=y
CONFIG_CMD_EXT2=y
CONFIG_CMD_EXT4=y
CONFIG_CMD_FAT=y
CONFIG_CMD_FS_GENERIC=y
CONFIG_CMD_MTDPARTS=y
CONFIG_MTDIDS_DEFAULT="nor0=w25q128-flash.0"
CONFIG_MTDPARTS_DEFAULT="mtdparts_nor1=256k(fsbl1),256k(fsbl2),2m(ssbl),256k(u-boot-env),-(nor_user)"
# CONFIG_SPL_DOS_PARTITION is not set
CONFIG_ISO_PARTITION=y
CONFIG_DEFAULT_DEVICE_TREE="stm32mp157c-bytedevkit-v1-3"
CONFIG_OF_SPL_REMOVE_PROPS="interrupt-parent"
CONFIG_DM_HWSPINLOCK=y
CONFIG_HWSPINLOCK_STM32=y
CONFIG_DM_I2C=y
CONFIG_SYS_I2C_STM32F7=y
CONFIG_DM_MAILBOX=y
CONFIG_STM32_IPCC=y
CONFIG_I2C_EEPROM=y
CONFIG_SYS_I2C_EEPROM_ADDR=0x57
CONFIG_SYS_I2C_EEPROM_BUS=1
CONFIG_SYS_EEPROM_SIZE=32768
CONFIG_SYS_EEPROM_PAGE_WRITE_BITS=8
CONFIG_SYS_I2C_EEPROM_ADDR_LEN=2
CONFIG_DM_MMC=y
CONFIG_STM32_SDMMC2=y
CONFIG_MTD=y
CONFIG_DM_MTD=y
CONFIG_SYS_MTDPARTS_RUNTIME=y
CONFIG_DM_SPI_FLASH=y
CONFIG_SPI_FLASH_ATMEL=y
CONFIG_SPI_FLASH_ISSI=y
CONFIG_SPI_FLASH_MACRONIX=y
CONFIG_SPI_FLASH_SPANSION=y
CONFIG_SPI_FLASH_STMICRO=y
CONFIG_SPI_FLASH_SST=y
CONFIG_SPI_FLASH_WINBOND=y
# CONFIG_SPI_FLASH_USE_4K_SECTORS is not set
CONFIG_SPI_FLASH_MTD=y
CONFIG_PINCONF=y
# CONFIG_SPL_PINCTRL_FULL is not set
CONFIG_PINCTRL_STMFX=y
CONFIG_DM_PMIC=y
# CONFIG_SPL_PMIC_CHILDREN is not set
CONFIG_PMIC_STPMIC1=y
CONFIG_DM_REGULATOR_FIXED=y
CONFIG_DM_REGULATOR_GPIO=y
CONFIG_DM_REGULATOR_STM32_VREFBUF=y
CONFIG_DM_REGULATOR_STPMIC1=y
CONFIG_STM32MP1_DDR_INTERACTIVE=y
CONFIG_REMOTEPROC_STM32_COPRO=y
CONFIG_SERIAL_RX_BUFFER=y
CONFIG_SPI=y
CONFIG_DM_SPI=y
CONFIG_STM32_QSPI=y
# CONFIG_REGEX is not set
# CONFIG_EFI_LOADER is not set
```

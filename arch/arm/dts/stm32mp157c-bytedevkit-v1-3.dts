// SPDX-License-Identifier: GPL-2.0
/*
 *  Copyright (C) 2022 bytes at work AG - http://www.bytesatwork.ch
 */

/dts-v1/;

#include "stm32mp157c-bytedevkit.dtsi"

&i2c2 {
	eeprom@57 {
		reg = <0x57>;
	};
};
